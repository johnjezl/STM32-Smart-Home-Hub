## buildroot/Config.in
```kconfig
# SmartHub custom packages

menu "SmartHub packages"

source "$BR2_EXTERNAL_SMARTHUB_PATH/package/lvgl/Config.in"
source "$BR2_EXTERNAL_SMARTHUB_PATH/package/smarthub-app/Config.in"
source "$BR2_EXTERNAL_SMARTHUB_PATH/package/smarthub-m4/Config.in"

endmenu
```

## buildroot/package/smarthub-app/Config.in
```kconfig
config BR2_PACKAGE_SMARTHUB_APP
	bool "smarthub-app"
	depends on BR2_INSTALL_LIBSTDCPP
	depends on BR2_TOOLCHAIN_HAS_THREADS
	select BR2_PACKAGE_LIBDRM
	select BR2_PACKAGE_LVGL
	select BR2_PACKAGE_MOSQUITTO
	select BR2_PACKAGE_JSON_FOR_MODERN_CPP
	select BR2_PACKAGE_OPENSSL
	select BR2_PACKAGE_SQLITE
	select BR2_PACKAGE_YAML_CPP
	help
	  The SmartHub application, its web dashboard and its default
	  configuration, built from this repository.
```

## buildroot/package/smarthub-m4/Config.in
```kconfig
config BR2_PACKAGE_SMARTHUB_M4
	bool "smarthub-m4"
	depends on BR2_PACKAGE_HOST_ARM_GNU_TOOLCHAIN_SUPPORTS
	help
	  The SmartHub Cortex-M4 firmware, built from this repository.
	  S80remoteproc starts it at boot.
```
